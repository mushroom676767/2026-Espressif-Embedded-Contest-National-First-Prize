## examples/esp_brookesia_phone/components/human_face_recognition/Kconfig
```kconfig
menu "models: human_face_feat"
    config HUMAN_FACE_FEAT_MFN_S8_V1
        bool "human_face_feat_mfn_s8_v1"
        default y

    config HUMAN_FACE_FEAT_MBF_S8_V1
        bool "human_face_feat_mbf_s8_v1"
        default n

    config DEFAULT_HUMAN_FACE_FEAT_MODEL
        int
        default 0 if HUMAN_FACE_FEAT_MFN_S8_V1
        default 1 if HUMAN_FACE_FEAT_MBF_S8_V1

    config HUMAN_FACE_FEAT_MODEL_IN_SDCARD
        bool "Load human_face_feat model from sdcard"
        default y

    config HUMAN_FACE_FEAT_MODEL_LOCATION
        int
        default 2 if HUMAN_FACE_FEAT_MODEL_IN_SDCARD

    config HUMAN_FACE_FEAT_MODEL_SDCARD_DIR
        string "human_face_feat model sdcard dir"
        default "espdl_models/p4"
        depends on HUMAN_FACE_FEAT_MODEL_IN_SDCARD
endmenu
```

## examples/esp_brookesia_phone/main/Kconfig.projbuild
```kconfig
menu "Example Configurations"
    config EXAMPLE_ENABLE_SD_CARD
        bool "Enable SD Card"
        default y
        help 
            Enabling this option will initialize the SD card, so the SD card needs to be inserted into the slot. Additionally, if using the Video Player example, an MJPEG format video must be saved on the SD card.
endmenu

menu "Cloud Uploader"
    config CLOUD_UPLOADER_URL
        string "Backend base URL"
        default ""

    config CLOUD_UPLOADER_DEVICE_CODE
        string "Device code"
        default "DEMO-CABINET-001"

    config CLOUD_UPLOADER_API_KEY
        string "X-Device-Key"
        default ""

    config CLOUD_UPLOADER_INSPECTION_UPLOAD_PATH
        string "Inspection image upload path"
        default "/api/inspection/upload-and-analyze"
endmenu
```
